## CMakeLists.txt
```
# SPDX-License-Identifier: Apache-2.0
#
# camera-app — STM32N6 + B-CAMS-IMX as a USB (UVC) webcam.
# Forked from zephyr/samples/subsys/usb/uvc (v4.4.1) and made our own;
# see README.md for what changed.

cmake_minimum_required(VERSION 3.20.0)

# This app targets exactly one hardware combo (NUCLEO-N657X0-Q + B-CAMS-IMX),
# so the shield is baked in here instead of the command line. The board is
# still chosen at build time: 'nucleo_n657x0_q//sb' for the dev RAM-load loop
# (scripts/swd-run.sh), plain 'nucleo_n657x0_q' for flash-boot shipping.
set(SHIELD st_b_cams_imx_mb1854)

find_package(Zephyr REQUIRED HINTS $ENV{ZEPHYR_BASE})
project(camera_app LANGUAGES C)

target_sources(app PRIVATE src/main.c src/app_usbd.c)
target_sources_ifdef(CONFIG_APP_FRAME_STATS app PRIVATE src/frame_stats.c)
target_include_directories(app PRIVATE src)
```

## Kconfig
```
# SPDX-License-Identifier: Apache-2.0
#
# camera-app options. The APP_USBD_* options replace the Zephyr-tree
# SAMPLE_USBD_* ones (those are sample-scoped and off-limits to applications).

menu "Camera app configuration"

config APP_USBD_MANUFACTURER
	string "USB device manufacturer string"
	default "pdnguyen"

config APP_USBD_PRODUCT
	string "USB device product string"
	default "STM32N6 IMX335 camera"

config APP_USBD_VID
	hex "USB device Vendor ID"
	default 0x2fe3
	help
	  0x2fe3 is the Zephyr Project VID — acceptable for local/dev use on
	  our own machines only; a real product must use its own VID.

config APP_USBD_PID
	hex "USB device Product ID"
	default 0x0011

config APP_USBD_SELF_POWERED
	bool "Set the Self-powered attribute"
	default y

config APP_USBD_REMOTE_WAKEUP
	bool "Set the Remote Wakeup attribute"

config APP_USBD_MAX_POWER
	int "bMaxPower value (2 mA units)"
	default 125
	range 0 250

config APP_VIDEO_MAX_RESOLUTIONS
	int "Maximum number of advertised resolutions"
	default 5
	help
	  Cap on how many resolutions are advertised to the USB host when the
	  camera supports a range. Each advertised format must also fit the
	  video buffer pool, so the effective list is usually shorter.

config APP_CAMERA_ANALOGUE_GAIN_MDB
	int "Initial analogue gain (mdB)"
	default 30000
	range 0 72000
	help
	  Applied once at startup via VIDEO_CID_ANALOGUE_GAIN. The IMX335
	  powers up at 0 dB, which is near-black indoors; 30 dB (30000) is a
	  usable indoor default. The sensor step is 300 mdB. Set 0 to leave
	  the sensor at its power-up default.

config APP_FRAME_STATS
	bool "Per-frame luma + motion-diff stats hook (M3)"
	default n
	help
	  When enabled, the frame loop peeks each camera buffer in transit to
	  the UVC host and logs periodic luma (mean/min/max), inter-frame
	  motion, fps and per-frame processing time. Read-only on pixel data;
	  when disabled the firmware is byte-for-byte the verified webcam.

config APP_FRAME_STATS_STRIDE
	int "Frame-stats sampling stride (pixels)"
	depends on APP_FRAME_STATS
	default 8
	range 1 64
	help
	  Sample one pixel every N in both x and y when computing the stats.
	  The camera buffer lives in non-cacheable AXISRAM that the CSI DMA is
	  actively writing, so a full per-pixel pass (stride 1) contends with
	  that DMA and measured ~336 ms/frame on hardware — collapsing the UVC
	  stream from ~20 to ~2 fps. Stride 8 reads 64x fewer bytes and keeps
	  the stream fast; the coarse luma/motion signal is unaffected at desk
	  scale. Set 1 only to reproduce the full-pass cost measurement.

endmenu

source "Kconfig.zephyr"
```

## prj.conf
```kconfig
# camera-app — everything the old monster build command line carried, owned here.

# --- USB device (new stack) -------------------------------------------------
CONFIG_USB_DEVICE_STACK_NEXT=y
CONFIG_USBD_VIDEO_CLASS=y
CONFIG_UDC_BUF_POOL_SIZE=2048
CONFIG_CDC_ACM_SERIAL_INITIALIZE_AT_BOOT=n

# --- Video capture ----------------------------------------------------------
CONFIG_VIDEO=y
# 2x 640x480 RGB565 = 1.2 MB. Pool lives OUTSIDE the image, in the runtime-only
# named region "AXISRAM1" (see app.overlay) — the image itself must stay inside
# the 511 KB BootROM window. Pool budget: W*H*2 bytes * 2 buffers <= 1536 KB.
CONFIG_VIDEO_BUFFER_POOL_HEAP_SIZE=1250000
CONFIG_VIDEO_BUFFER_POOL_ZEPHYR_REGION=y
CONFIG_VIDEO_BUFFER_POOL_ZEPHYR_REGION_NAME="AXISRAM1"

# --- Logging ----------------------------------------------------------------
CONFIG_LOG=y
# Kept for ONE remaining reason (do not remove without addressing it):
# 1. Deferred mode + CONFIG_LOG_PRINTK silently drops ALL boot-time output
#    (the 1 KB buffer overflows before the console thread runs) — see
#    CLAUDE.md "Debugging" trap #1.
# (The OTHER historical reason — masking the imx335 boot-timing race, trap #3 —
#  is GONE as of 2026-06-14: the race is fixed in imx335.c and validated on cold
#  flash-boot with DEFERRED logging. So a proper fix here is to switch to a large
#  deferred buffer + log thread rather than sync logging; deferred only because
#  of reason 1 now. See docs/camera-bringup-debug-log.md §2026-06-14.)
CONFIG_LOG_MODE_IMMEDIATE=y
CONFIG_UDC_DRIVER_LOG_LEVEL_WRN=y
CONFIG_USBD_LOG_LEVEL_WRN=y
CONFIG_USBD_VIDEO_LOG_LEVEL_WRN=y
CONFIG_VIDEO_LOG_LEVEL_WRN=y

# --- Kernel -----------------------------------------------------------------
CONFIG_POLL=y
CONFIG_MAIN_STACK_SIZE=4096
```

## app.overlay
```dts
/*
 * camera-app devicetree overlay — NUCLEO-N657X0-Q only.
 *
 * SPDX-License-Identifier: Apache-2.0
 */

/ {
	uvc: uvc {
		compatible = "zephyr,uvc-device";
	};
};

/*
 * Video buffer pool region (same change as overlays/nucleo_n657x0_q_vidpool.overlay,
 * which stays for building upstream samples as references — keep in sync).
 *
 * System RAM stays on the stock 511 KB axisram2 (0x...180400) because that is
 * the only window the N6 BootROM will load an image into (serial boot verified;
 * flash boot consistent). The big FLEXRAM+AXISRAM1 space is used at runtime
 * only, as the named region "AXISRAM1" holding the video buffer pool
 * (CONFIG_VIDEO_BUFFER_POOL_ZEPHYR_REGION=y + _NAME="AXISRAM1").
 *
 * Shrink axisram1 so the named region cannot overlap system RAM:
 * 0x0..0x180000 = 400K FLEXRAM + 624K AXISRAM1 + 512K of AXISRAM2 = 1536 KB,
 * ending 1 KB before system RAM at 0x180400.
 */
&axisram1 {
	reg = <0x0 0x180000>;
};
```

## src/main.c
```c
/*
 * camera-app — expose the B-CAMS-IMX (IMX335) camera as a USB UVC webcam.
 *
 * Forked from zephyr/samples/subsys/usb/uvc (v4.4.1). Changes from upstream:
 * - video-encoder (zephyr,videoenc) paths removed — no encoder on this board
 * - startup analogue gain applied from CONFIG_APP_CAMERA_ANALOGUE_GAIN_MDB
 * - USB device setup via our own app_usbd.c (APP_USBD_* options)
 *
 * Copyright (c) 2025 tinyVision.ai Inc.
 * SPDX-License-Identifier: Apache-2.0
 */

#include <stdint.h>

#include <app_usbd.h>

#include <zephyr/device.h>
#include <zephyr/usb/usbd.h>
#include <zephyr/drivers/video.h>
#include <zephyr/drivers/video-controls.h>
#include <zephyr/logging/log.h>
#include <zephyr/usb/class/usbd_uvc.h>

#ifdef CONFIG_APP_FRAME_STATS
#include "frame_stats.h"
#endif

LOG_MODULE_REGISTER(camera_app, LOG_LEVEL_INF);

const static struct device *const uvc_dev = DEVICE_DT_GET(DT_NODELABEL(uvc));
const static struct device *const video_dev = DEVICE_DT_GET(DT_CHOSEN(zephyr_camera));

/* Format capabilities of video_dev, used everywhere through the app */
static struct video_caps video_caps = {.type = VIDEO_BUF_TYPE_OUTPUT};

/* Pixel formats present in one of the UVC 1.5 standard */
static bool app_is_supported_format(uint32_t pixfmt)
{
	return pixfmt == VIDEO_PIX_FMT_JPEG ||
	       pixfmt == VIDEO_PIX_FMT_YUYV ||
	       pixfmt == VIDEO_PIX_FMT_NV12 ||
	       pixfmt == VIDEO_PIX_FMT_H264;
}

static bool app_has_supported_format(void)
{
	const struct video_format_cap *const fmts = video_caps.format_caps;

	for (int i = 0; fmts[i].pixelformat != 0; i++) {
		if (app_is_supported_format(fmts[i].pixelformat)) {
			return true;
		}
	}

	return false;
}

static int app_add_format(uint32_t pixfmt, uint32_t width, uint32_t height, bool has_sup_fmts)
{
	struct video_format fmt = {
		.pixelformat = pixfmt,
		.width = width,
		.height = height,
		.type = VIDEO_BUF_TYPE_OUTPUT,
	};
	int ret;

	/* If the system has any standard pixel format, only propose them to the host */
	if (has_sup_fmts && !app_is_supported_format(pixfmt)) {
		return 0;
	}

	/* Set the format to get the size */
	ret = video_set_compose_format(video_dev, &fmt);
	if (ret != 0) {
		LOG_ERR("Could not set the format of %s to %s %ux%u (size %u)",
			video_dev->name, VIDEO_FOURCC_TO_STR(fmt.pixelformat),
			fmt.width, fmt.height, fmt.size);
		return ret;
	}

	if (fmt.size > (CONFIG_VIDEO_BUFFER_POOL_HEAP_SIZE / CONFIG_VIDEO_BUFFER_POOL_NUM_MAX)) {
		LOG_WRN("Skipping format %ux%u", fmt.width, fmt.height);
		return 0;
	}

	ret = uvc_device_add_format(uvc_dev, &fmt);
	if (ret == -ENOMEM) {
		/* If there are too many formats, ignore the error, just list fewer formats */
		return 0;
	}
	return ret;
}

struct video_resolution {
	uint16_t width;
	uint16_t height;
};

static struct video_resolution video_common_fmts[] = {
	{ .width = 160,		.height = 120,	},	/* QQVGA */
	{ .width = 320,		.height = 240,	},	/* QVGA */
	{ .width = 640,		.height = 480,	},	/* VGA */
	{ .width = 854,		.height = 480,	},	/* WVGA */
	{ .width = 800,		.height = 600,	},	/* SVGA */
	{ .width = 1280,	.height = 720,	},	/* HD */
	{ .width = 1280,	.height = 1024,	},	/* SXGA */
	{ .width = 1920,	.height = 1080,	},	/* FHD */
	{ .width = 3840,	.height = 2160,	},	/* UHD */
};

/* Submit to UVC only the formats expected to be working (enough memory for the size, etc.) */
static int app_add_filtered_formats(void)
{
	const bool has_sup_fmts = app_has_supported_format();
	int ret;

	for (int i = 0; video_caps.format_caps[i].pixelformat != 0; i++) {
		const struct video_format_cap *vcap = &video_caps.format_caps[i];
		int count = 1;

		ret = app_add_format(vcap->pixelformat, vcap->width_min, vcap->height_min,
				     has_sup_fmts);
		if (ret != 0) {
			return ret;
		}

		if (vcap->width_min != vcap->width_max || vcap->height_min != vcap->height_max) {
			ret = app_add_format(vcap->pixelformat, vcap->width_max, vcap->height_max,
					     has_sup_fmts);
			if (ret != 0) {
				return ret;
			}

			count++;
		}

		if (vcap->width_step == 0 && vcap->height_step == 0) {
			continue;
		}

		/* RANGE Resolution processing */
		for (int j = 0; j < ARRAY_SIZE(video_common_fmts); j++) {
			if (count >= CONFIG_APP_VIDEO_MAX_RESOLUTIONS) {
				break;
			}

			if (!IN_RANGE(video_common_fmts[j].width,
				      vcap->width_min, vcap->width_max) ||
			    !IN_RANGE(video_common_fmts[j].height,
				      vcap->height_min, vcap->height_max)) {
				continue;
			}

			if ((video_common_fmts[j].width - vcap->width_min) % vcap->width_step ||
			    (video_common_fmts[j].height - vcap->height_min) % vcap->height_step) {
				continue;
			}

			ret = app_add_format(vcap->pixelformat, video_common_fmts[j].width,
					     video_common_fmts[j].height, has_sup_fmts);
			if (ret != 0) {
				return ret;
			}

			count++;
		}
	}

	return 0;
}

static void app_apply_initial_gain(void)
{
	struct video_control gain = {
		.id = VIDEO_CID_ANALOGUE_GAIN,
		.val = CONFIG_APP_CAMERA_ANALOGUE_GAIN_MDB,
	};
	int ret;

	if (CONFIG_APP_CAMERA_ANALOGUE_GAIN_MDB == 0) {
		return;
	}

	ret = video_set_ctrl(video_dev, &gain);
	if (ret != 0) {
		LOG_WRN("Failed to set analogue gain to %d mdB (%d)", gain.val, ret);
	} else {
		LOG_INF("Analogue gain set to %d mdB", gain.val);
	}
}

int main(void)
{
	struct usbd_context *usbd;
	struct video_buffer *vbuf;
	struct video_format fmt = {0};
	struct video_frmival frmival = {0};
	struct k_poll_signal sig;
	struct k_poll_event evt[1];
	k_timeout_t timeout = K_FOREVER;
	int ret;

	if (!device_is_ready(video_dev)) {
		LOG_ERR("video source %s failed to initialize", video_dev->name);
		return -ENODEV;
	}

	app_apply_initial_gain();

	ret = video_get_caps(video_dev, &video_caps);
	if (ret != 0) {
		LOG_ERR("Unable to retrieve video capabilities");
		return 0;
	}

	/* Initialize control descriptors from the video device */
	uvc_device_init(uvc_dev, video_dev);

	/* Fill the table of formats */
	ret = app_add_filtered_formats();
	if (ret != 0) {
		return ret;
	}

	/* Prepare the UVC device for being run */
	ret = uvc_device_enable(uvc_dev);
	if (ret != 0) {
		return ret;
	}

	usbd = app_usbd_init_device(NULL);
	if (usbd == NULL) {
		return -ENODEV;
	}

	ret = usbd_enable(usbd);
	if (ret != 0) {
		return ret;
	}

	LOG_INF("Waiting the host to select the video format");

	while (true) {
		fmt.type = VIDEO_BUF_TYPE_INPUT;

		ret = video_get_format(uvc_dev, &fmt);
		if (ret == 0) {
			break;
		}
		if (ret != -EAGAIN) {
			LOG_ERR("Failed to get the video format");
			return ret;
		}

		k_sleep(K_MSEC(10));
	}

	ret = video_get_frmival(uvc_dev, &frmival);
	if (ret != 0) {
		LOG_ERR("Failed to get the video frame interval");
		return ret;
	}

	LOG_INF("The host selected format '%s' %ux%u at frame interval %u/%u",
		VIDEO_FOURCC_TO_STR(fmt.pixelformat), fmt.width, fmt.height,
		frmival.numerator, frmival.denominator);

#ifdef CONFIG_APP_FRAME_STATS
	frame_stats_init(fmt.width, fmt.height, fmt.pixelformat);
#endif

	fmt.type = VIDEO_BUF_TYPE_OUTPUT;
	ret = video_set_compose_format(video_dev, &fmt);
	if (ret != 0) {
		LOG_ERR("Could not set the format of %s to %s %ux%u (size %u)",
			video_dev->name, VIDEO_FOURCC_TO_STR(fmt.pixelformat),
			fmt.width, fmt.height, fmt.size);
	}

	ret = video_set_frmival(video_dev, &frmival);
	if (ret != 0) {
		LOG_WRN("Could not set the framerate of %s", video_dev->name);
	}

	LOG_INF("Preparing %u buffers of %u bytes", CONFIG_VIDEO_BUFFER_POOL_NUM_MAX, fmt.size);

	for (int i = 0; i < CONFIG_VIDEO_BUFFER_POOL_NUM_MAX; i++) {
		vbuf = video_buffer_aligned_alloc(fmt.size, CONFIG_VIDEO_BUFFER_POOL_ALIGN,
						  K_NO_WAIT);
		if (vbuf == NULL) {
			LOG_ERR("Could not allocate the video buffer");
			return -ENOMEM;
		}

		vbuf->type = VIDEO_BUF_TYPE_OUTPUT;

		ret = video_enqueue(video_dev, vbuf);
		if (ret != 0) {
			LOG_ERR("Could not enqueue video buffer");
			return ret;
		}
	}

	LOG_DBG("Preparing signaling for %s input/output", video_dev->name);

	k_poll_signal_init(&sig);
	k_poll_event_init(&evt[0], K_POLL_TYPE_SIGNAL, K_POLL_MODE_NOTIFY_ONLY, &sig);

	ret = video_set_signal(video_dev, &sig);
	if (ret != 0) {
		LOG_WRN("Failed to setup the signal on %s output endpoint", video_dev->name);
		timeout = K_MSEC(1);
	}

	ret = video_set_signal(uvc_dev, &sig);
	if (ret != 0) {
		LOG_ERR("Failed to setup the signal on %s input endpoint", uvc_dev->name);
		return ret;
	}

	LOG_INF("Starting the video transfer");

	ret = video_stream_start(video_dev, VIDEO_BUF_TYPE_OUTPUT);
	if (ret != 0) {
		LOG_ERR("Failed to start %s", video_dev->name);
		return ret;
	}

	while (true) {
		ret = k_poll(evt, ARRAY_SIZE(evt), timeout);
		if (ret != 0 && ret != -EAGAIN) {
			LOG_ERR("Poll exited with status %d", ret);
			return ret;
		}

		/* Filled camera buffers -> UVC (to the USB host) */
#ifdef CONFIG_APP_FRAME_STATS
		/*
		 * Faithful to video_transfer_buffer(video_dev, uvc_dev, OUTPUT,
		 * INPUT, K_NO_WAIT), but peeks the buffer read-only between the
		 * dequeue and the enqueue. -EAGAIN (no filled buffer yet) leaves
		 * ret set and falls through to the shared error check, exactly as
		 * the original would.
		 */
		struct video_buffer *pbuf = &(struct video_buffer){.type = VIDEO_BUF_TYPE_OUTPUT};

		ret = video_dequeue(video_dev, &pbuf, K_NO_WAIT);
		if (ret == 0) {
			frame_stats_process(pbuf->buffer, pbuf->bytesused);
			pbuf->type = VIDEO_BUF_TYPE_INPUT;
			ret = video_enqueue(uvc_dev, pbuf);
		}
#else
		ret = video_transfer_buffer(video_dev, uvc_dev,
					    VIDEO_BUF_TYPE_OUTPUT, VIDEO_BUF_TYPE_INPUT,
					    K_NO_WAIT);
#endif
		if (ret != 0 && ret != -EAGAIN) {
			LOG_ERR("Failed to transfer from %s to %s",
				video_dev->name, uvc_dev->name);
			return ret;
		}

		/* Buffers the host is done with -> back to the camera */
		ret = video_transfer_buffer(uvc_dev, video_dev,
					    VIDEO_BUF_TYPE_INPUT, VIDEO_BUF_TYPE_OUTPUT,
					    K_NO_WAIT);
		if (ret != 0 && ret != -EAGAIN) {
			LOG_ERR("Failed to transfer from %s to %s",
				uvc_dev->name, video_dev->name);
			return ret;
		}

		k_poll_signal_reset(&sig);
	}

	return 0;
}
```

## src/app_usbd.c
```c
/*
 * USB device setup for camera-app.
 *
 * Forked from zephyr/samples/subsys/usb/common/sample_usbd_init.c (v4.4.1),
 * renamed SAMPLE_USBD_* -> APP_USBD_* and trimmed of the BOS/USB 2.0
 * extension descriptor example code.
 *
 * Copyright (c) 2023 Nordic Semiconductor ASA
 * SPDX-License-Identifier: Apache-2.0
 */

#include <stdint.h>

#include <zephyr/device.h>
#include <zephyr/usb/usbd.h>

#include <zephyr/logging/log.h>
LOG_MODULE_REGISTER(app_usbd);

/* By default, do not register the USB DFU class DFU mode instance. */
static const char *const blocklist[] = {
	"dfu_dfu",
	NULL,
};

USBD_DEVICE_DEFINE(app_usbd,
		   DEVICE_DT_GET(DT_NODELABEL(zephyr_udc0)),
		   CONFIG_APP_USBD_VID, CONFIG_APP_USBD_PID);

USBD_DESC_LANG_DEFINE(app_lang);
USBD_DESC_MANUFACTURER_DEFINE(app_mfr, CONFIG_APP_USBD_MANUFACTURER);
USBD_DESC_PRODUCT_DEFINE(app_product, CONFIG_APP_USBD_PRODUCT);
IF_ENABLED(CONFIG_HWINFO, (USBD_DESC_SERIAL_NUMBER_DEFINE(app_sn)));

USBD_DESC_CONFIG_DEFINE(fs_cfg_desc, "FS Configuration");
USBD_DESC_CONFIG_DEFINE(hs_cfg_desc, "HS Configuration");

static const uint8_t attributes = (IS_ENABLED(CONFIG_APP_USBD_SELF_POWERED) ?
				   USB_SCD_SELF_POWERED : 0) |
				  (IS_ENABLED(CONFIG_APP_USBD_REMOTE_WAKEUP) ?
				   USB_SCD_REMOTE_WAKEUP : 0);

USBD_CONFIGURATION_DEFINE(app_fs_config,
			  attributes,
			  CONFIG_APP_USBD_MAX_POWER, &fs_cfg_desc);

USBD_CONFIGURATION_DEFINE(app_hs_config,
			  attributes,
			  CONFIG_APP_USBD_MAX_POWER, &hs_cfg_desc);

static void app_fix_code_triple(struct usbd_context *uds_ctx,
				const enum usbd_speed speed)
{
	/* Always use class code information from Interface Descriptors */
	if (IS_ENABLED(CONFIG_USBD_CDC_ACM_CLASS) ||
	    IS_ENABLED(CONFIG_USBD_CDC_ECM_CLASS) ||
	    IS_ENABLED(CONFIG_USBD_CDC_NCM_CLASS) ||
	    IS_ENABLED(CONFIG_USBD_MIDI2_CLASS) ||
	    IS_ENABLED(CONFIG_USBD_AUDIO2_CLASS) ||
	    IS_ENABLED(CONFIG_USBD_VIDEO_CLASS)) {
		/*
		 * Class with multiple interfaces have an Interface
		 * Association Descriptor available, use an appropriate triple
		 * to indicate it.
		 */
		usbd_device_set_code_triple(uds_ctx, speed,
					    USB_BCC_MISCELLANEOUS, 0x02, 0x01);
	} else {
		usbd_device_set_code_triple(uds_ctx, speed, 0, 0, 0);
	}
}

struct usbd_context *app_usbd_setup_device(usbd_msg_cb_t msg_cb)
{
	int err;

	err = usbd_add_descriptor(&app_usbd, &app_lang);
	if (err) {
		LOG_ERR("Failed to initialize language descriptor (%d)", err);
		return NULL;
	}

	err = usbd_add_descriptor(&app_usbd, &app_mfr);
	if (err) {
		LOG_ERR("Failed to initialize manufacturer descriptor (%d)", err);
		return NULL;
	}

	err = usbd_add_descriptor(&app_usbd, &app_product);
	if (err) {
		LOG_ERR("Failed to initialize product descriptor (%d)", err);
		return NULL;
	}

	IF_ENABLED(CONFIG_HWINFO, (
		err = usbd_add_descriptor(&app_usbd, &app_sn);
	))
	if (err) {
		LOG_ERR("Failed to initialize SN descriptor (%d)", err);
		return NULL;
	}

	if (USBD_SUPPORTS_HIGH_SPEED &&
	    usbd_caps_speed(&app_usbd) == USBD_SPEED_HS) {
		err = usbd_add_configuration(&app_usbd, USBD_SPEED_HS,
					     &app_hs_config);
		if (err) {
			LOG_ERR("Failed to add High-Speed configuration");
			return NULL;
		}

		err = usbd_register_all_classes(&app_usbd, USBD_SPEED_HS, 1,
						blocklist);
		if (err) {
			LOG_ERR("Failed to add register classes");
			return NULL;
		}

		app_fix_code_triple(&app_usbd, USBD_SPEED_HS);
	}

	err = usbd_add_configuration(&app_usbd, USBD_SPEED_FS,
				     &app_fs_config);
	if (err) {
		LOG_ERR("Failed to add Full-Speed configuration");
		return NULL;
	}

	err = usbd_register_all_classes(&app_usbd, USBD_SPEED_FS, 1, blocklist);
	if (err) {
		LOG_ERR("Failed to add register classes");
		return NULL;
	}

	app_fix_code_triple(&app_usbd, USBD_SPEED_FS);
	usbd_self_powered(&app_usbd, attributes & USB_SCD_SELF_POWERED);

	if (msg_cb != NULL) {
		err = usbd_msg_register_cb(&app_usbd, msg_cb);
		if (err) {
			LOG_ERR("Failed to register message callback");
			return NULL;
		}
	}

	return &app_usbd;
}

struct usbd_context *app_usbd_init_device(usbd_msg_cb_t msg_cb)
{
	int err;

	if (app_usbd_setup_device(msg_cb) == NULL) {
		return NULL;
	}

	err = usbd_init(&app_usbd);
	if (err) {
		LOG_ERR("Failed to initialize device support");
		return NULL;
	}

	return &app_usbd;
}
```

## src/app_usbd.h
```c
/*
 * USB device setup for camera-app.
 *
 * Forked from zephyr/samples/subsys/usb/common/sample_usbd.h (v4.4.1) —
 * the in-tree helper is sample-scoped and must not be referenced by
 * applications, so we own a copy.
 *
 * Copyright (c) 2023 Nordic Semiconductor ASA.
 * SPDX-License-Identifier: Apache-2.0
 */

#ifndef APP_USBD_H
#define APP_USBD_H

#include <zephyr/usb/usbd.h>

/*
 * Configure and initialize the USB device from the APP_USBD_* Kconfig
 * options: device context, string descriptors, configuration, all available
 * class instances. Returns the initialized context, or NULL on failure.
 */
struct usbd_context *app_usbd_init_device(usbd_msg_cb_t msg_cb);

/*
 * Same, but stops short of usbd_init() so the caller can add descriptors or
 * features first.
 */
struct usbd_context *app_usbd_setup_device(usbd_msg_cb_t msg_cb);

#endif /* APP_USBD_H */
```

## src/frame_stats.c
```c
/*
 * frame_stats — M3 "processing on target" hook for camera-app.
 *
 * See frame_stats.h. Read-only luma + motion-diff analysis with periodic logging.
 *
 * Copyright (c) 2026 pdnguyen
 * SPDX-License-Identifier: Apache-2.0
 */

#include "frame_stats.h"

#include <stdint.h>

#include <zephyr/kernel.h>
#include <zephyr/drivers/video.h>
#include <zephyr/logging/log.h>

LOG_MODULE_REGISTER(frame_stats, LOG_LEVEL_INF);

/* Coarse motion signature: GRIDxGRID blocks of average luma. */
#define GRID 8U
#define NUM_BLOCKS (GRID * GRID)

/* Negotiated format, stored at init. */
static uint32_t fs_width;
static uint32_t fs_height;
static uint32_t fs_pixfmt;

/* Previous frame's coarse signature (average luma per block, 0..255). */
static uint8_t prev_grid[NUM_BLOCKS];
static bool have_prev;

/* Reporting window accumulators (~1 s windows). */
static uint32_t win_frames;
static int64_t win_start_ms;
static uint64_t win_proc_us; /* summed per-frame processing time */

/*
 * Read luma for a given pixel column for the configured pixel format.
 *
 * YUYV (a.k.a. YUY2) packs "Y0 U0 Y1 V0 ..." so luma is at every even byte
 * offset: pixel x -> byte offset 2*x. For any OTHER pixel format we don't know
 * the layout, so we fall back to treating every byte as an intensity sample
 * (i.e. "pixel x" -> byte offset x). This fallback is approximate (it mixes
 * chroma/packed bytes into the "luma" stats) but keeps the hook format-agnostic
 * and never reads out of bounds.
 */
static inline uint32_t luma_byte_offset(uint32_t x)
{
	return (fs_pixfmt == VIDEO_PIX_FMT_YUYV) ? (x * 2U) : x;
}

void frame_stats_init(uint32_t width, uint32_t height, uint32_t pixfmt)
{
	fs_width = width;
	fs_height = height;
	fs_pixfmt = pixfmt;

	have_prev = false;
	win_frames = 0;
	win_proc_us = 0;
	win_start_ms = k_uptime_get();

	for (uint32_t i = 0; i < NUM_BLOCKS; i++) {
		prev_grid[i] = 0;
	}

	LOG_INF("frame_stats init: %ux%u fourcc %s (luma %s, stride %d)", width, height,
		VIDEO_FOURCC_TO_STR(pixfmt),
		(pixfmt == VIDEO_PIX_FMT_YUYV) ? "even-byte" : "every-byte fallback",
		CONFIG_APP_FRAME_STATS_STRIDE);
}

void frame_stats_process(const uint8_t *buf, uint32_t bytesused)
{
	uint32_t cycles_start = k_cycle_get_32();

	if (buf == NULL || bytesused == 0 || fs_width == 0 || fs_height == 0) {
		return;
	}

	/*
	 * Per-block accumulators for the coarse signature, plus whole-frame
	 * luma min/max/sum. We sample one pixel every STRIDE in x and y: the
	 * frame lives in non-cacheable AXISRAM that the CSI DMA is actively
	 * writing, so a full per-pixel pass (stride 1) contends with that DMA
	 * and measured ~336 ms/frame on hardware (UVC dropped 20->2 fps).
	 * Stride 8 reads 64x fewer bytes; the coarse luma/motion signal is
	 * unaffected at desk scale.
	 */
	const uint32_t stride = (CONFIG_APP_FRAME_STATS_STRIDE < 1)
				? 1U : (uint32_t)CONFIG_APP_FRAME_STATS_STRIDE;
	uint64_t block_sum[NUM_BLOCKS] = {0};
	uint32_t block_cnt[NUM_BLOCKS] = {0};
	uint64_t luma_sum = 0;
	uint32_t luma_cnt = 0;
	uint8_t luma_min = 255;
	uint8_t luma_max = 0;

	for (uint32_t y = 0; y < fs_height; y += stride) {
		uint32_t row_base = y * fs_width;
		uint32_t by = (y * GRID) / fs_height; /* 0..GRID-1 */

		for (uint32_t x = 0; x < fs_width; x += stride) {
			uint32_t off = luma_byte_offset(row_base + x);

			if (off >= bytesused) {
				/* Truncated/short frame — stop safely. */
				goto done_scan;
			}

			uint8_t l = buf[off];
			uint32_t bx = (x * GRID) / fs_width; /* 0..GRID-1 */
			uint32_t b = by * GRID + bx;

			block_sum[b] += l;
			block_cnt[b]++;

			luma_sum += l;
			luma_cnt++;
			if (l < luma_min) {
				luma_min = l;
			}
			if (l > luma_max) {
				luma_max = l;
			}
		}
	}

done_scan:
	if (luma_cnt == 0) {
		return;
	}

	/* Build the coarse signature and compute motion vs the previous frame. */
	uint8_t grid[NUM_BLOCKS];
	uint32_t motion = 0;

	for (uint32_t b = 0; b < NUM_BLOCKS; b++) {
		grid[b] = (block_cnt[b] > 0) ? (uint8_t)(block_sum[b] / block_cnt[b]) : 0;

		if (have_prev) {
			int diff = (int)grid[b] - (int)prev_grid[b];

			motion += (diff < 0) ? (uint32_t)(-diff) : (uint32_t)diff;
		}
	}

	bool first_frame = !have_prev;

	for (uint32_t b = 0; b < NUM_BLOCKS; b++) {
		prev_grid[b] = grid[b];
	}
	have_prev = true;

	/* Accumulate this window. */
	uint8_t luma_mean = (uint8_t)(luma_sum / luma_cnt);
	uint32_t cycles_end = k_cycle_get_32();

	win_proc_us += k_cyc_to_us_floor32(cycles_end - cycles_start);
	win_frames++;

	/* Emit one summary line per ~1 s window. */
	int64_t now_ms = k_uptime_get();
	int64_t elapsed_ms = now_ms - win_start_ms;

	if (elapsed_ms >= 1000) {
		uint32_t fps = (uint32_t)((win_frames * 1000U) / (uint32_t)elapsed_ms);
		uint32_t avg_proc_us = (uint32_t)(win_proc_us / win_frames);

		LOG_INF("fps=%u luma mean=%u min=%u max=%u motion=%u%s proc_avg=%u us (n=%u)",
			fps, luma_mean, luma_min, luma_max, motion,
			first_frame ? " (first)" : "", avg_proc_us, luma_cnt);

		win_frames = 0;
		win_proc_us = 0;
		win_start_ms = now_ms;
	}
}
```

## src/frame_stats.h
```c
/*
 * frame_stats — M3 "processing on target" hook for camera-app.
 *
 * Read-only, in-transit per-frame analysis of camera buffers on their way to
 * the UVC host: luma (mean/min/max), inter-frame motion (8x8 coarse grid diff),
 * fps and per-frame processing time. Never modifies pixel data. The whole hook
 * is gated behind CONFIG_APP_FRAME_STATS (default n); when off it compiles out
 * and the firmware is byte-for-byte the verified webcam.
 *
 * Copyright (c) 2026 pdnguyen
 * SPDX-License-Identifier: Apache-2.0
 */

#ifndef APP_FRAME_STATS_H_
#define APP_FRAME_STATS_H_

#include <stdint.h>

/*
 * Configure the analyzer with the negotiated format and reset all accumulators.
 * Call once after the host has selected the video format (width/height/pixfmt
 * valid). pixfmt is a Zephyr VIDEO_PIX_FMT_* fourcc.
 */
void frame_stats_init(uint32_t width, uint32_t height, uint32_t pixfmt);

/*
 * Analyze one frame's pixel data (read-only). 'buf' points at the start of the
 * pixel data and 'bytesused' is the count of valid bytes. Accumulates stats and
 * emits a periodic (~1 Hz) LOG_INF summary line.
 */
void frame_stats_process(const uint8_t *buf, uint32_t bytesused);

#endif /* APP_FRAME_STATS_H_ */
```
